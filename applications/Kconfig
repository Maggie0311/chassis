## applications/Kconfig
```kconfig
menu "Car Customize Config"

menu "Choose Car model Config"
    #选择机器人类型
    choice
        prompt "select Types of robot" 
        default CORE_USING_INFANTRY
        config CORE_USING_INFANTRY  #步兵
            bool "infantry"
        config CORE_USING_HERO      #英雄
            bool "hero"
		config CORE_USING_SENTRY    #哨兵
			bool "sentry"
		config CORE_USING_ENGINEER  #工程
			bool "engineer"			
    endchoice
    #当为哨兵时
    if  CORE_USING_SENTRY
        choice
            prompt "select Types of sentry robot" 
            default CORE_USING_OMNI_SENTRY
              
            #全向轮哨兵-26新
            config CORE_USING_OMNI_SENTRY
                bool "omni wheel sentry"    

            #麦轮哨兵-退役于2024-被全向轮哨兵取代
            config CORE_USING_MECANUM_SENTRY
                bool "mecanum sentry"    
            
            #舵轮哨兵-2025年研发，因为在联盟赛上总是被肘击而光荣退役
            config CORE_USING_STEER_SENTRY
                bool "steer sentry"               
        endchoice
    endif

    #当为普通步兵时
    if  CORE_USING_INFANTRY
        choice
           	prompt "select Types of infantry robot" 
            default CORE_USING_2025_INFANTRY_1

            #2024全向轮步兵-目前还没名字
            config CORE_USING_2024_INFANTRY_OMNI
                bool "2024 infantry OMNI"  

            config CORE_USING_2025_INFANTRY_1   
                bool "2025 infantry 1 zhijiao"              #2025步兵1(按照出车时间排序)

            config CORE_USING_2025_INFANTRY_2
                bool "2025 infantry 2 daojiao"              #2025步兵2

            config CORE_USING_2025_INFANTRY_3
                bool "2025 infantry 3 omni"                 #2025步兵3
            
            config CORE_USING_2026_INFANTRY_1
                bool "2026 infantry 1 omni"                 #2026步兵1
            
            config CORE_USING_2026_INFANTRY_2
                bool "2026 infantry 2 omni"                 #2026步兵2

            #2024麦轮步兵-飞将-轮距很窄-左右容易晃；轮子大-为飞坡设计-但飞坡效果并不理想
            config CORE_USING_2024_NEW_INFANTRY
                bool "2024 new infantry"            
                             
            #碳板步兵-老学长-性能还很不错
            config CORE_USING_CARBON_INFANTRY
                bool "carbon infantry"

            #瓦力步兵-2023复刻的碳步-但是各方面性能都不如碳步-很差
            config CORE_USING_WALL_E_INFANTRY
                bool "wall_e infantry"

        endchoice
    endif

    #当为英雄时
    if  CORE_USING_HERO
        choice
            prompt "select Types of hero robot" 
            default CORE_USING_2026_HERO
          
            #2024英雄-骁将
            config CORE_USING_2026_HERO
                bool "2026 hero"

            #英雄双马尾
            config CORE_USING_BUNCHES_HERO
                bool "SMW hero"

            #复刻老英雄
            config CORE_USING_NEW_OLD_HERO
                bool "old-sub hero"

            #老英雄
            config CORE_USING_NATION_HERO
                bool "old hero"

        endchoice

    endif

endmenu 



#底盘相关配置 每次更改兵种最好检查一下有无更改部分
menu "Board function module"

    choice #选择超级电容类型
        prompt "select superCap kind"
        default USE_CAPACITY_3
        
        #超级电容并联
        config USE_CAPACITY_3
            bool "select superCap_3"
    endchoice    

    menu "CAN device set"
        config GIMBAL_CAN_DEVICE_NAME       #云台CAN设备名称
            int "the specific gimbal can device"
            default "2"

        config SCPR_CAN_DEVICE_NAME            #超级电容CAN设备名称
            int "the specific superCap can device"
            default "1"
    endmenu

    #是否开启rtt监视
    config CORE_USING_RTT_MONITOR
        bool "Enable RTT monitor"
        default n

    #是否进行底盘测试
    menuconfig CORE_USING_TEST
        bool "Enable test chassis"
        default n   

    menuconfig BSP_USING_VOFA    
        bool "select using vofa"
        depends on CORE_USING_TEST     
        default n    

        config BSP_TEST_USART_NAME          #调试数据可视化串口
            string "the specific vofa usart device"
            depends on BSP_USING_VOFA     
            default "uart3"
        config BSP_TEST_USART_BOUD          #vofa波特率
            int "the vofa usart bound"
            depends on BSP_USING_VOFA 
            default "115200"

    menuconfig CORE_USING_REMOTE        #遥控器直接调试底盘
        bool "use dji remote"
        depends on CORE_USING_TEST
        default n                  
        config BSP_REMOTE_USART_NAME        #遥控器串口
            string "the specific remote usart device"
            depends on CORE_USING_REMOTE
            default "uart6"

    #是否需要使用和视觉通信的串口
    menuconfig BSP_USING_VISUAL_USART
        bool "Use visual com"
        default n
        depends on CORE_USING_SENTRY

        config BSP_VISUAL_USART_NAME         
            string "the specific Visual usart device"
            depends on BSP_USING_VISUAL_USART  
            default "uart2"  
        config BSP_VISUAL_USART_BOUD
            int "the Visual usart bound"
            depends on BSP_USING_VISUAL_USART  
            default "115200"

        if BSP_USING_VISUAL_USART
            choice
                prompt "select Types of usart" 
                default VISUAL_USART_USING_NORMAL
                config VISUAL_USART_USING_NORMAL  #普通串口
                    bool "normal usart"
                config VISUAL_USART_USING_RS485  #RS485串口(不能同时收发)
                    bool "usart-RS485"	
            endchoice
        endif
endmenu #menu "Board function module"




endmenu
```

## board/Kconfig
```kconfig
menu "Hardware Drivers Config"

config SOC_STM32F407ZG
    bool
    select SOC_SERIES_STM32F4
    select RT_USING_COMPONENTS_INIT
    select RT_USING_USER_MAIN
    default y

menu "On-chip Peripheral Drivers"
    menuconfig BSP_USING_CAN168M
        bool "Enable 168M can"
        select CAN168M_ENABLE_
        default y
    
    config BSP_USING_ON_CHIP_FLASH
        bool "Enable On-Chip Flash"
        default n

    config BSP_USING_GPIO
        bool "Enable GPIO"
        select RT_USING_PIN
        default y

    menuconfig BSP_USING_UART
        bool "Enable UART"
        default y
        select RT_USING_SERIAL
        if BSP_USING_UART
            config BSP_USING_UART1
                bool "Enable UART1"
                default y
            if BSP_USING_UART1
                config BSP_UART1_RX_USING_DMA
                    bool "Enable UART1 RX DMA"
                    depends on BSP_USING_UART1 && RT_SERIAL_USING_DMA
                    default n
                config BSP_UART1_TX_USING_DMA
                    bool "Enable UART1 TX DMA"
                    depends on BSP_USING_UART1 && RT_SERIAL_USING_DMA
                    default n
            endif

            config BSP_USING_UART2
                bool "Enable UART2"
                default y
            if BSP_USING_UART2
                config BSP_UART2_RX_USING_DMA
                    bool "Enable UART2 RX DMA"
                    depends on BSP_USING_UART2 && RT_SERIAL_USING_DMA
                    default n
                config BSP_UART2_TX_USING_DMA
                    bool "Enable UART2 TX DMA"
                    depends on BSP_USING_UART2 && RT_SERIAL_USING_DMA
                    default n
            endif

            config BSP_USING_UART3
                bool "Enable UART3"
                default y
            if BSP_USING_UART3
                config BSP_UART3_RX_USING_DMA
                    bool "Enable UART3 RX DMA"
                    depends on BSP_USING_UART3 && RT_SERIAL_USING_DMA
                    default n
                config BSP_UART3_TX_USING_DMA
                    bool "Enable UART3 TX DMA"
                    depends on BSP_USING_UART3 && RT_SERIAL_USING_DMA
                    default n
            endif

            config BSP_USING_UART4
                bool "Enable UART4"
                default y
            if BSP_USING_UART4
                config BSP_UART4_RX_USING_DMA
                    bool "Enable UART4 RX DMA"
                    depends on BSP_USING_UART4 && RT_SERIAL_USING_DMA
                    default n
                config BSP_UART4_TX_USING_DMA
                    bool "Enable UART4 TX DMA"
                    depends on BSP_USING_UART4 && RT_SERIAL_USING_DMA
                    default n
            endif
            
            config BSP_USING_UART6
                bool "Enable UART6"
                default y
            if BSP_USING_UART6
                config BSP_UART6_RX_USING_DMA
                    bool "Enable UART6 RX DMA"
                    depends on BSP_USING_UART6 && RT_SERIAL_USING_DMA
                    default n
                config BSP_UART6_TX_USING_DMA
                    bool "Enable UART6 TX DMA"
                    depends on BSP_USING_UART6 && RT_SERIAL_USING_DMA
                    default n
            endif
        endif

    menuconfig BSP_USING_PWM
        bool "Enable pwm"
        default n
        select RT_USING_PWM
        if BSP_USING_PWM

        menuconfig BSP_USING_PWM1           
            bool "Enable timer1 output pwm"
            default y
            if BSP_USING_PWM1
                config BSP_USING_PWM1_CH1
                    bool "Enable PWM1 channel1 (PE9)"
                    default y
                config BSP_USING_PWM1_CH2
                    bool "Enable PWM1 channel2 (PE11)"
                    default y
                config BSP_USING_PWM1_CH3
                    bool "Enable PWM1 channel3 (PE13)"
                    default y
                config BSP_USING_PWM1_CH4
                    bool "Enable PWM1 channel4 (PE14)"
                    default y
            endif

#       menuconfig BSP_USING_PWM2
#            bool "Enable timer2 output pwm"
#            default y
#            if BSP_USING_PWM2
#                config BSP_USING_PWM2_CH1
#                    bool "Enable PWM2 channel1 (PA0)"
#                    default y
#                config BSP_USING_PWM2_CH2
#                    bool "Enable PWM2 channel2 (PA1)"
#                    default y
#                config BSP_USING_PWM2_CH3
#                    bool "Enable PWM2 channel3 (PA2)"
#                    default y
#                config BSP_USING_PWM2_CH4
#                    bool "Enable PWM2 channel4 (PA3)"
#                    default y
#            endif

        menuconfig BSP_USING_PWM4
            bool "Enable timer4 output pwm"
            default y
            if BSP_USING_PWM4
                config BSP_USING_PWM4_CH1
                    bool "Enable PWM4 channel1 (PD12)"
                    default y
                config BSP_USING_PWM4_CH2
                    bool "Enable PWM4 channel2 (PD13)"
                    default y
                config BSP_USING_PWM4_CH3
                    bool "Enable PWM4 channel3 (PD14)"
                    default y
                config BSP_USING_PWM4_CH4
                    bool "Enable PWM4 channel4 (PD15)"
                    default y
            endif

        menuconfig BSP_USING_PWM9       #timer9只有两个PWM通道
            bool "Enable timer9 output pwm"
            default y
            if BSP_USING_PWM9
                config BSP_USING_PWM9_CH1
                    bool "Enable PWM9 channel1 (PE5)"
                    default y
                config BSP_USING_PWM9_CH2
                    bool "Enable PWM9 channel2 (PE6)"
                    default y
            endif

        endif
            
    menuconfig BSP_USING_SPI
        bool "Enable SPI BUS"
        default n
        select RT_USING_SPI
        if BSP_USING_SPI
            config BSP_USING_SPI1
                bool "Enable SPI1 BUS"
                default y

            config BSP_SPI1_TX_USING_DMA
                bool "Enable SPI1 TX DMA"
                depends on BSP_USING_SPI1
                default n
                
            config BSP_SPI1_RX_USING_DMA
                bool "Enable SPI1 RX DMA"
                depends on BSP_USING_SPI1
                select BSP_SPI1_TX_USING_DMA
                default n
            
            config BSP_USING_SPI2
                bool "Enable SPI2 BUS"
                default y

            config BSP_SPI2_TX_USING_DMA
                bool "Enable SPI2 TX DMA"
                depends on BSP_USING_SPI2
                default n
                
            config BSP_SPI2_RX_USING_DMA
                bool "Enable SPI2 RX DMA"
                depends on BSP_USING_SPI2
                select BSP_SPI2_TX_USING_DMA
                default n
        endif

    
    menuconfig BSP_USING_CAN
        bool "Enable CAN"
        default n
        select RT_USING_CAN
        if BSP_USING_CAN
            config BSP_USING_CAN1
                bool "Enable CAN1"
                default n

            config BSP_USING_CAN2
                bool "Enable CAN2"
                default n

            config RT_CAN_USING_HDR
                bool "Enable CAN RX HDR"
                depends on BSP_USING_CAN &&(BSP_USING_CAN1||BSP_USING_CAN2)
                default n
        endif
        
    config BSP_USING_HARDFAULT_RESET
        bool "Enable HardfaultReset"
        default n

    config BSP_USING_DSP
        bool "Enable STM32 DSP Libarary"
        default n
    
endmenu

menu "Board extended module Drivers"

endmenu
 
endmenu
```
